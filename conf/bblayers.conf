## conf/bblayers.conf
```bitbake
# POKY_BBLAYERS_CONF_VERSION is increased each time build/conf/bblayers.conf
# changes incompatibly
POKY_BBLAYERS_CONF_VERSION = "2"

BBPATH = "${TOPDIR}"
BBFILES ?= ""

BBLAYERS ?= " \
  /home/noreng/src/oe/systemd-c/kirkstone/poky/meta \
  /home/noreng/src/oe/systemd-c/kirkstone/poky/meta-poky \
  /home/noreng/src/oe/systemd-c/kirkstone/meta-raspberrypi \
  /home/noreng/src/oe/systemd-c/kirkstone/meta-custom \
  /home/noreng/src/oe/systemd-c/kirkstone/poky/meta-yocto-bsp \
  "
```

## conf/layer.conf
```bitbake
# /home/noreng/ISOs/Yocto/SystemD-C/meta-custom/conf/layer.conf

BBPATH .= ":${LAYERDIR}"

# We have recipes in recipes-* directories, so add them to BBFILES
BBFILES += "${LAYERDIR}/recipes-*/*/*.bb \
            ${LAYERDIR}/recipes-*/*/*.bbappend"

# Set a priority for your layer. 6 is standard for custom user layers.
BBFILE_COLLECTIONS += "meta-systemdc"
BBFILE_PATTERN_meta-systemdc = "^${LAYERDIR}/"
BBFILE_PRIORITY_meta-systemdc = "6"

# Define the supported machine layer dependencies.
# This assumes your custom layer works with any core Yocto setup.
LAYERDEPENDS_meta-systemdc = "core"
LAYERSERIES_COMPAT_meta-systemdc = "kirkstone"
```
